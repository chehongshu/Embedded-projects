# include "12864.h"
# include "delay.h"

const u8 HZ[] ={
							0x00,0xFE,0x12,0x22,0xC2,0x22,0x1A,0x02,0xFE,0x00,0x00,0x00,
							0x08,0x07,0x02,0x01,0x00,0x01,0x02,0x00,0x03,0x04,0x0F,0x00,/*"风"0*/
							0x88,0x68,0xFF,0x28,0x40,0xFE,0x12,0xF2,0x12,0x91,0x71,0x00,
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							0x08,0x05,0x02,0x0D,0x00,0x0F,0x04,0x04,0x04,0x0F,0x00,0x00,/*"始",?*/

};

const u8 ASCALL[]=              // ASCII
{
			
	0x00,0x00,0x00,0x00,0x00, // - -
	0x00,0x00,0x5F,0x00,0x00, // -!-
	0x00,0x07,0x00,0x07,0x00, // -"-
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	0x55,0x2A,0x55,0x2A,0x55, // --
};


//向LCD发送8字节数据
void LCD_Send_8Bits(u8 dat)
{
    u8 i = 0;

    for (i=0; i<8; i++)
    {
        LCD_SCLK_0();
        if ( dat&0x80 )
        {
            LCD_DAT_1();
        }
        else
        {
            LCD_DAT_0();
        }
        LCD_SCLK_1();
        dat <<= 1;
    }
}

//向LCD写指令
void LCD_Send_Order(u8 cmd)
{
	LCD_RS_0();
  LCD_Send_8Bits(cmd);
}

//向LCD写数据
void LCD_Send_Data(u8 dat)
{
  LCD_RS_1();
  LCD_Send_8Bits(dat);
}

//显示汉字
void LCD_HZ(u8 x, u8 y,  u8 dat)
{
	  u8 i, j;
    LCD_CS_0();

    for (i=0; i<2; i++)
    {
        LCD_Add_XY(x+i, y);
        for (j=0; j<12; j++)
        {
            LCD_Send_Data(*(HZ + 24*(dat-'0') + 12*i + j));
        }
    }
    
    LCD_CS_1();
}

//汉字选中
void LCD_HZ_OP(u8 x, u8 y,  u8 dat)
{
	  u8 i, j;
    LCD_CS_0();

    for (i=0; i<2; i++)
    {
        LCD_Add_XY(x+i, y);
        for (j=0; j<12; j++)
        {
            LCD_Send_Data( ~(*(HZ + 24*(dat-'0') + 12*i + j)) );
        }
    }
    
    LCD_CS_1();
}

//显示汉字
void LCD_HZS(u8 x,u8 y,u8 *string)
{
	u8 i=0;
	while(*(string+i))
	{
		LCD_HZ(x,y+13*i,*(string+i));
		i++;
	}
}

//选中汉字
void LCD_HZS_OP(u8 x,u8 y,u8 *string)
{
	u8 i=0;
	while(*(string+i))
	{
		LCD_HZ_OP(x,y+13*i,*(string+i));
		i++;
	}
}

//显示ASCII字符
void LCD_ASCALL(u8 c)
{
	u8 i;
	LCD_CS_0();
	for (i=0;i<5;i++)
	{	
		LCD_Send_Data(*(ASCALL+5*(c-' ')+i));/*????LCD,?????8???????????1*/
	}
	LCD_CS_1();
}

//选中ASCII字符
void LCD_ASCALL_OP(u8 c)
{
	u8 i;
	LCD_CS_0();
	for (i=0;i<5;i++)
	{
		LCD_Send_Data(~(*(ASCALL+5*(c-' ')+i)));/*????LCD,?????8???????????1*/
	}
	LCD_CS_1();
}

//显示字符串
void LCD_ASCALLS(u8 *string)
{
	u8 i=0;
	while(*(string+i))
	{
        LCD_ASCALL(*(string+i));
		i++;
	}
}

//选中字符串
void LCD_ASCALLS_OP(u8 *string)
{
	u8 i=0;
	while(*(string+i))
	{
        LCD_ASCALL_OP(*(string+i));
		i++;
	}
}

//显示整数
void LCD_int(int dat)
{
	u8 i=0;
	char string[10]={0};
	for(i=0;dat>0;i++)
	{
		string[i]=dat%10;
		dat/=10;
	}
	if(i==0)
	{
		LCD_ASCALL('0');
		return;
	}
	else
	{

		for(i--;;)
		{
			
			LCD_ASCALL('0'+string[i]);

			if(i>0)
                i--;
			else
                return;
		}
	}
}

//设置坐标
void LCD_Add_XY(u8 x, u8 y)
{
	LCD_CS_0();
    x--;
    y--;

    LCD_Send_Order(0xB0 + x);
    LCD_Send_Order(0x10 + (y>>4&0x0F));
    LCD_Send_Order(y&0x0F);
}

//初始化LCD
void LCD_Init(void)
{
  MYGPIO_Init();
  LCD_CS_0();
  LCD_RST_0();
  delay_us(20);
  LCD_RST_1();
  delay_us(20);
  LCD_Send_Order(0xe2);	 /*软复位*/
	delay_us(5);
	LCD_Send_Order(0x2c);  /*升压步骤1*/
	delay_us(5);
	LCD_Send_Order(0x2e);  /*升压步骤2*/
	delay_us(5);
	LCD_Send_Order(0x2f);  /*升压步骤3*/
	delay_us(5);
	LCD_Send_Order(0x23);  /*粗调对比度,可调范围0x20~0x27*/
	LCD_Send_Order(0x81);  /*微调对比度*/
	LCD_Send_Order(0x2f);  /*0x28,微调对比度的值,可调范围0x00~0x3f*/
	LCD_Send_Order(0xa2);  /*1/9偏压比(bias)*/
	LCD_Send_Order(0xc8);  /*行顺序扫描:自上而下*/
	LCD_Send_Order(0xa0);  /*列顺序扫描:自左而右*/
	LCD_Send_Order(0x40);  /*起始行:从第一行开始*/
	LCD_Send_Order(0xaf);  /*开显示*/
	LCD_Clear_Screen();
	LCD_CS_1();
}

//IO口初始化
void MYGPIO_Init()
{
	GPIO_InitTypeDef GPIO_InitStructure;
	
	RCC_APB2PeriphClockCmd(RCC_APB2Periph_GPIOC, ENABLE);
	
	GPIO_InitStructure.GPIO_Pin = GPIO_Pin_3 | GPIO_Pin_4 | GPIO_Pin_5 | GPIO_Pin_6 | GPIO_Pin_7;
	GPIO_InitStructure.GPIO_Mode = GPIO_Mode_Out_PP;
	GPIO_InitStructure.GPIO_Speed = GPIO_Speed_50MHz;
	GPIO_Init(GPIOC, &GPIO_InitStructure);
}

//清屏
void LCD_Clear_Screen(void)
{
	  u8 i, j;
    LCD_CS_0();

    for (i=0; i<9; i++)
    {
    	LCD_Send_Order(0xb0+i);
    	LCD_Send_Order(0x10);
    	LCD_Send_Order(0x00);

        for (j=0; j<132; j++)
        {
            LCD_Send_Data(0x00);
        }
    }
    LCD_CS_1();
}

//清除行
void LCD_Clear_Line(u8 _X)
{
  unsigned char j;
  LCD_CS_0();
  LCD_Send_Order(0xb0+(_X-1));
  LCD_Send_Order(0x10);
  LCD_Send_Order(0x00);
  for(j=0;j<132;j++)
  {
    LCD_Send_Data(0x00);
  }

  LCD_CS_1();
}

